## meta-carspeedboy/conf/layer.conf
```bitbake
# We have a conf and classes directory, add to BBPATH
BBPATH .= ":${LAYERDIR}"

# We have recipes-* directories, add to BBFILES
BBFILES += "${LAYERDIR}/recipes-*/*/*.bb \
            ${LAYERDIR}/recipes-*/*/*.bbappend"

BBFILE_COLLECTIONS += "meta-carspeedboy"
BBFILE_PATTERN_meta-carspeedboy = "^${LAYERDIR}/"
BBFILE_PRIORITY_meta-carspeedboy = "10"

LAYERDEPENDS_meta-carspeedboy = "core"
LAYERSERIES_COMPAT_meta-carspeedboy = "kirkstone langdale mickledore nanbield scarthgap"

# Layer version
LAYERVERSION_meta-carspeedboy = "1"

# Additional license directories
LICENSE_PATH += "${LAYERDIR}/licenses"
```
